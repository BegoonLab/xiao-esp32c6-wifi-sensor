## main/Kconfig.projbuild
```kconfig
menu "XIAO Sensor Configuration"
    choice SENSOR_CONNECTION_TYPE
        prompt "Select Sensor Connection Type"
        default SENSOR_CONNECTION_WIFI_MQTT
        help
            Choose the type of sensor connection to use.
            - **WiFi + MQTT**: WiFi and MQTT.
            - **ZigBee**: ZigBee.

        config SENSOR_CONNECTION_WIFI_MQTT
            bool "WiFi + MQTT"
            help
                Enable WiFi and MQTT connection.

        config SENSOR_CONNECTION_ZIGBEE
            bool "ZigBee"
            help
                Enable ZigBee connection.

    endchoice

    config SENSOR_ID
        string "Sensor ID"
        default ""
        help
            Unique identifier for the sensor.

            If left empty, the device's MAC address will be used as the Sensor ID.

            This ID is used to construct MQTT topics for publishing data (WiFi mode)
            or identify the device in the ZigBee network.

    menu "Wi-Fi Configuration"
        depends on SENSOR_CONNECTION_WIFI_MQTT
        config ESP_WIFI_SSID
            string "WiFi SSID"
            default "myssid"
            help
                SSID (network name) for the sensor to connect to.

        config ESP_WIFI_PASSWORD
            string "WiFi Password"
            default "mypassword"
            help
                WiFi password (WPA3-PSK) for the sensor to use.

        config ESP_MAXIMUM_RETRY
            int "Maximum retry"
            default 5
            help
                Set the maximum retry to avoid the station reconnecting to the AP indefinitely when the AP is nonexistent.

        config ESP_WIFI_COUNTRY_CODE
            string "WiFi Country Code"
            default "01"
            help
                Configure the country code for WiFi operations.

                This setting is used by the `esp_wifi_set_country_code` function to define regional WiFi parameters.

                - **Default**: "01" (World Safe Mode)
                - **Supported Codes**: "01", "AT", "AU", "BE", "BG", "BR", "CA", "CH", "CN", "CY", "CZ",
                  "DE", "DK", "EE", "ES", "FI", "FR", "GB", "GR", "HK", "HR", "HU", "IE", "IN",
                  "IS", "IT", "JP", "KR", "LI", "LT", "LU", "LV", "MT", "MX", "NL", "NO",
                  "NZ", "PL", "PT", "RO", "SE", "SI", "SK", "TW", "US"

                **Behavior:**
                - **ieee80211d_enabled**:
                  1. **Enabled**:
                     - The country info of the connected AP is used.
                     - If disconnected, it reverts to the configured country code.
                  2. **Disabled**:
                     - The configured country code is always used.
                - The country configuration is stored in flash memory.
                - Changing the country info updates the SoftAP's country IE in probe responses/beacons.
                - PHY initialization data switches based on the country info.

                **Notes:**
                - Setting to "01" (World Safe Mode) disables the country IE in SoftAP mode.
                - The third character of the country code string must be one of the following: ' ', 'O', 'I', 'X'. Otherwise, it defaults to ' '.
        choice ESP_WIFI_ANTENNA
            prompt "WiFi Antenna Selection"
            default WIFI_ANTENNA_BUILT_IN
            help
                Select which antenna to use for WiFi operations.

            config WIFI_ANTENNA_BUILT_IN
                bool "Built-in Antenna"
                help
                    Use the device's built-in antenna for WiFi connectivity.

            config WIFI_ANTENNA_EXTERNAL
                bool "External Antenna"
                help
                    Use an external antenna for WiFi connectivity.
        endchoice
    endmenu

    menu "MQTT Configuration"
        depends on SENSOR_CONNECTION_WIFI_MQTT
        config MQTT_BROKER_URI
            string "MQTT Broker URI"
            default "mqtt://192.168.1.100"
            help
                URI of the MQTT broker to connect to.

        config MQTT_BROKER_PORT
            int "MQTT Broker Port"
            default 1883
            help
                Port number of the MQTT broker.

        config MQTT_TOPIC
            string "MQTT Topic"
            default "xiao/sensor"
            help
                MQTT topic for publishing sensor data.

        choice MQTT_QOS
             prompt "MQTT Quality of Service"
             default MQTT_QOS_2
             help
                 Quality of Service (QoS) level for MQTT messages:

                 - **0**: At most once – Messages are delivered according to the best efforts of the operating environment. Messages may be lost.
                 - **1**: At least once – Ensures that the message arrives at the receiver, but duplicates may occur.
                 - **2**: Exactly once – Ensures that each message is received only once by the intended recipients.

             config MQTT_QOS_0
                 bool "0 (At most once)"
                 help
                     QoS level 0: Messages are delivered at most once, with no confirmation.

             config MQTT_QOS_1
                 bool "1 (At least once)"
                 help
                     QoS level 1: Messages are delivered at least once, ensuring delivery but allowing duplicates.

             config MQTT_QOS_2
                 bool "2 (Exactly once)"
                 help
                     QoS level 2: Messages are delivered exactly once by using a four-step handshake. This is the safest and slowest level.
        endchoice

        config MQTT_RETAIN
            int "MQTT Retain Flag"
            default 1
            help
                Retain flag for MQTT messages.

        config MQTT_PUBLISHING_TIMEOUT_PERIOD
            int "MQTT Publishing Timeout Period"
            default 30
            help
                Timeout period in seconds for MQTT publishing.

        config MQTT_ENABLE_AUTH
            bool "Enable MQTT Authentication"
            default n
            help
                Enable authentication for connecting to the MQTT broker.

        config MQTT_USERNAME
            string "MQTT Username"
            depends on MQTT_ENABLE_AUTH
            default "user"
            help
                Username for authenticating with the MQTT broker.

        config MQTT_PASSWORD
            string "MQTT Password"
            depends on MQTT_ENABLE_AUTH
            default "password"
            help
                Password for authenticating with the MQTT broker.
    endmenu

    menu "ZigBee Configuration"
        depends on SENSOR_CONNECTION_ZIGBEE
        config ZIGBEE_ANTENNA_EXTERNAL
            bool "External Antenna"
            help
                Use an external antenna for ZigBee connectivity.
    endmenu

    menu "Sensor Configuration"
        config SENSOR_BME680
            bool "BME680"
            default n
            help
                Enable configuration for the BME680 sensor.

        menu "BME680 Configuration"
            depends on SENSOR_BME680

            config BME680_POWER_PIN
                int "BME680 Power Pin"
                default 21
                help
                    GPIO pin used to power up and down the BME680 sensor.

            config BME680_I2C_ADDR
                hex "BME680 I2C Address"
                default 0x77
                help
                    I2C address of the BME680 sensor.

            config BME680_I2C_PORT
                int "BME680 I2C Port"
                default 0
                help
                    I2C port number to which the BME680 sensor is connected.

            config BME680_I2C_SDA
                int "BME680 I2C SDA Pin"
                default 22
                help
                    GPIO pin used for I2C SDA (data) line for the BME680 sensor.

            config BME680_I2C_SCL
                int "BME680 I2C SCL Pin"
                default 23
                help
                    GPIO pin used for I2C SCL (clock) line for the BME680 sensor.
        endmenu

        config SENSOR_BME280
            bool "BME280"
            default n
            help
                Enable configuration for the BME280 sensor.

        menu "BME280 Configuration"
            depends on SENSOR_BME280

            config BME280_POWER_PIN
                int "BME280 Power Pin"
                default 21
                help
                    GPIO pin used to power up and down the BME280 sensor.

            config BME280_I2C_ADDR
                hex "BME280 I2C Address"
                default 0x76
                help
                    I2C address of the BME280 sensor.

            config BME280_I2C_PORT
                int "BME280 I2C Port"
                default 0
                help
                    I2C port number to which the BME280 sensor is connected.

            config BME280_I2C_SDA
                int "BME280 I2C SDA Pin"
                default 22
                help
                    GPIO pin used for I2C SDA (data) line for the BME280 sensor.

            config BME280_I2C_SCL
                int "BME280 I2C SCL Pin"
                default 23
                help
                    GPIO pin used for I2C SCL (clock) line for the BME280 sensor.
        endmenu

        config SENSOR_SGP41
            bool "SGP41"
            default n
            help
                Enable configuration for the SGP41 sensor.

        menu "SGP41 Configuration"
            depends on SENSOR_SGP41

            config SGP41_I2C_ADDR
                hex "SGP41 I2C Address"
                default 0x59
                help
                    I2C address of the SGP41 sensor.

            config SGP41_I2C_PORT
                int "SGP41 I2C Port"
                default 0
                help
                    I2C port number to which the SGP41 sensor is connected.

            config SGP41_I2C_SDA
                int "SGP41 I2C SDA Pin"
                default 22
                help
                    GPIO pin used for I2C SDA (data) line for the SGP41 sensor.

            config SGP41_I2C_SCL
                int "SGP41 I2C SCL Pin"
                default 23
                help
                    GPIO pin used for I2C SCL (clock) line for the SGP41 sensor.
        endmenu
    endmenu

    config ENABLE_BATTERY_CHECK
        bool "Enable Battery Voltage Check"
        default n
        help
            Enable checking of the battery voltage.
            When enabled, the ADC Configuration menu will be displayed to configure ADC settings related to battery monitoring.
    menu "ADC Configuration"
        depends on ENABLE_BATTERY_CHECK

        config BATTERY_VOLTAGE_DIVIDER_RATIO_INT
            int "Battery Voltage Divider Ratio (x100)"
            default 200
            help
                Voltage divider ratio used to scale down the battery voltage before measuring via ADC.
                This ensures the voltage does not exceed the ADC's maximum input voltage (3.3 V).

                - **Representation:** The ratio is stored as an integer multiplied by 100.
                  For example:
                  - 7.5 is represented as 750
                  - 10.0 is represented as 1000

                - **Usage:** In the code, divide this value by 100.0 to get the actual ratio.
    endmenu

    menu "Power Management Configuration"
        config WAKEUP_TIME_SEC
            int "Wakeup Time (seconds)"
            default 300
            help
                Defines the duration in seconds that the device will remain in deep sleep before waking up.

                - **Default**: 300 seconds (5 minutes)
                - **Usage**: Determines how long the device stays in deep sleep before it automatically wakes up.
                - **Range**: 5 - 86400 (5 seconds to 24 hours)
    endmenu
endmenu
```

## sdkconfig.defaults
```kconfig
CONFIG_IDF_TARGET="esp32c6"
CONFIG_IDF_TARGET_ESP32C6=y

#
# Partition Table
#
CONFIG_PARTITION_TABLE_CUSTOM=y
CONFIG_PARTITION_TABLE_CUSTOM_FILENAME="partitions.csv"
CONFIG_PARTITION_TABLE_FILENAME="partitions.csv"
CONFIG_PARTITION_TABLE_OFFSET=0x8000
CONFIG_PARTITION_TABLE_MD5=y
# end of Partition Table

#
# mbedTLS
#
CONFIG_MBEDTLS_HARDWARE_AES=n
CONFIG_MBEDTLS_HARDWARE_MPI=n
CONFIG_MBEDTLS_HARDWARE_SHA=n
CONFIG_MBEDTLS_CMAC_C=y
CONFIG_MBEDTLS_SSL_PROTO_DTLS=y
CONFIG_MBEDTLS_KEY_EXCHANGE_ECJPAKE=y
# end of TLS Key Exchange Methods

CONFIG_MBEDTLS_ECJPAKE_C=y
# end of mbedTLS

#
# Zboss
#
CONFIG_ZB_ENABLED=y
CONFIG_ZB_ZED=y
# end of Zboss

# end of Component config

#
# Log output
#
CONFIG_LOG_DEFAULT_LEVEL_NONE=y
# CONFIG_LOG_DEFAULT_LEVEL_ERROR is not set
# CONFIG_LOG_DEFAULT_LEVEL_WARN is not set
# CONFIG_LOG_DEFAULT_LEVEL_INFO is not set
# CONFIG_LOG_DEFAULT_LEVEL_DEBUG is not set
# CONFIG_LOG_DEFAULT_LEVEL_VERBOSE is not set
CONFIG_LOG_DEFAULT_LEVEL=0
CONFIG_LOG_MAXIMUM_EQUALS_DEFAULT=y
# CONFIG_LOG_MAXIMUM_LEVEL_ERROR is not set
# CONFIG_LOG_MAXIMUM_LEVEL_WARN is not set
# CONFIG_LOG_MAXIMUM_LEVEL_INFO is not set
# CONFIG_LOG_MAXIMUM_LEVEL_DEBUG is not set
# CONFIG_LOG_MAXIMUM_LEVEL_VERBOSE is not set
CONFIG_LOG_MAXIMUM_LEVEL=0
# CONFIG_LOG_MASTER_LEVEL is not set
CONFIG_LOG_COLORS=y
CONFIG_LOG_TIMESTAMP_SOURCE_RTOS=y
# CONFIG_LOG_TIMESTAMP_SOURCE_SYSTEM is not set
# end of Log output

#
# Compiler options
#
# CONFIG_COMPILER_OPTIMIZATION_DEBUG is not set
CONFIG_COMPILER_OPTIMIZATION_PERF=y

#
# PHY
#
CONFIG_ESP_PHY_INIT_DATA_IN_PARTITION=y

# Default sensor configuration
CONFIG_SENSOR_BME280=y
CONFIG_BME280_POWER_PIN=21
CONFIG_BME280_I2C_ADDR=0x76
CONFIG_BME280_I2C_PORT=0
CONFIG_BME280_I2C_SDA=22
CONFIG_BME280_I2C_SCL=23
```
